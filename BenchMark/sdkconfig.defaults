## CarRaceDemo/sdkconfig.defaults
```kconfig
#
# ESP32-specific
#
CONFIG_ESP32_DEFAULT_CPU_FREQ_240=y
CONFIG_ESP32_DEFAULT_CPU_FREQ_MHZ=240

#
# ESP32S2-specific
#
CONFIG_ESP32S2_DEFAULT_CPU_FREQ_240=y
CONFIG_ESP32S2_DEFAULT_CPU_FREQ_MHZ=240

#
# ESP32S3-specific
#
CONFIG_ESP32S3_DEFAULT_CPU_FREQ_240=y
CONFIG_ESP32S3_DEFAULT_CPU_FREQ_MHZ=240
```

## Kconfig
```kconfig
menu "SSD1306 Configuration"

    choice INTERFACE
        prompt "Interface"
        default I2C_INTERFACE
        help
            Select Interface.
        config I2C_INTERFACE
            bool "I2C Interface"
            help
                I2C Interface.
        config SPI_INTERFACE
            bool "SPI Interface"
            help
                SPI Interface.
    endchoice

if I2C_INTERFACE

    choice PANEL
        prompt "Panel Type"
        default SSD1306_128x64
        help
            Select Panel Type.
        config SSD1306_128x32
            bool "128x32 Panel"
            help
                Panel is 128x32.
        config SSD1306_128x64
            bool "128x64 Panel"
            help
                Panel is 128x64.
    endchoice

    config SCL_GPIO
        int "SCL GPIO number"
        range 0 34
        default 22
        help
            GPIO number (IOxx) to I2C SCL.
            Some GPIOs are used for other purposes (flash connections, etc.) and cannot be used to I2C.
            GPIOs 35-39 are input-only so cannot be used as outputs.

    config SDA_GPIO
        int "SDA GPIO number"
        range 0 34
        default 21
        help
            GPIO number (IOxx) to I2C SDA.
            Some GPIOs are used for other purposes (flash connections, etc.) and cannot be used to I2C.
            GPIOs 35-39 are input-only so cannot be used as outputs.

endif

    config RESET_GPIO
        int "RESET GPIO number"
        range -1 34
        default -1
        help
            GPIO number (IOxx) to RESET.
            When it is -1, RESET isn't performed.
            Some GPIOs are used for other purposes (flash connections, etc.) and cannot be used to Reset.
            GPIOs 35-39 are input-only so cannot be used as outputs.

if SPI_INTERFACE
    config CS_GPIO
        int "CS GPIO number"
        range 0 34
        default 15
        help
            GPIO number (IOxx) to SPI CS.
            Some GPIOs are used for other purposes (flash connections, etc.) and cannot be used to CS.
            GPIOs 35-39 are input-only so cannot be used as outputs.

    config DC_GPIO
        int "DC GPIO number"
        range 0 34
        default 33
        help
            GPIO number (IOxx) to SPI DC.
            Some GPIOs are used for other purposes (flash connections, etc.) and cannot be used to DC.
            GPIOs 35-39 are input-only so cannot be used as outputs.

endif

endmenu
```

## components/ssd1306/Kconfig.projbuild
```kconfig
menu "SSD1306 Configuration"

	choice INTERFACE
		prompt "Interface"
		default I2C_INTERFACE
		help
			Select Interface.
		config I2C_INTERFACE
			bool "I2C Interface"
			help
				I2C Interface.
		config SPI_INTERFACE
			bool "SPI Interface"
			help
				SPI Interface.
	endchoice

	choice PANEL
		prompt "Panel Type"
		default SSD1306_128x64
		help
			Select Panel Type.
		config SSD1306_128x32
			bool "128x32 Panel"
			help
				Panel is 128x32.
		config SSD1306_128x64
			bool "128x64 Panel"
			help
				Panel is 128x64.
	endchoice

	config OFFSETX
		int "GRAM X OFFSET"
		range 0 99
		default 0
		help
			When your TFT have offset(X), set it.

	config FLIP
		bool "Flip upside down"
		default false
		help
			Flip upside down.

	config SCL_GPIO
		depends on I2C_INTERFACE
		int "SCL GPIO number"
		range 0 SOC_GPIO_OUT_RANGE_MAX
		default 22 if IDF_TARGET_ESP32
		default  2 if IDF_TARGET_ESP32S2 || IDF_TARGET_ESP32S3
		default  6 # C3 and others
		help
			GPIO number (IOxx) to I2C SCL.
			Some GPIOs are used for other purposes (flash connections, etc.) and cannot be used to I2C.
			GPIOs 35-39 are input-only so cannot be used as outputs.

	config SDA_GPIO
		depends on I2C_INTERFACE
		int "SDA GPIO number"
		range 0 SOC_GPIO_OUT_RANGE_MAX
		default 21 if IDF_TARGET_ESP32
		default  1 if IDF_TARGET_ESP32S2 || IDF_TARGET_ESP32S3
		default  5 # C3 and others
		help
			GPIO number (IOxx) to I2C SDA.
			Some GPIOs are used for other purposes (flash connections, etc.) and cannot be used to I2C.
			GPIOs 35-39 are input-only so cannot be used as outputs.

	config MOSI_GPIO
		depends on SPI_INTERFACE
		int "MOSI GPIO number"
		range 0 SOC_GPIO_OUT_RANGE_MAX
		default 23 if IDF_TARGET_ESP32
		default 35 if IDF_TARGET_ESP32S2 || IDF_TARGET_ESP32S3
		default  1 # C3 and others
		help
			GPIO number (IOxx) to SPI MOSI.
			Some GPIOs are used for other purposes (flash connections, etc.) and cannot be used to MOSI.
			On the ESP32, GPIOs 35-39 are input-only so cannot be used as outputs.
			On the ESP32-S2, GPIO 46 is input-only so cannot be used as outputs.

	config SCLK_GPIO
		depends on SPI_INTERFACE
		int "SCLK GPIO number"
		range 0 SOC_GPIO_OUT_RANGE_MAX
		default 18 if IDF_TARGET_ESP32
		default 36 if IDF_TARGET_ESP32S2 || IDF_TARGET_ESP32S3
		default  2 # C3 and others
		help
			GPIO number (IOxx) to SPI SCLK.
			Some GPIOs are used for other purposes (flash connections, etc.) and cannot be used to SCLK.
			On the ESP32, GPIOs 35-39 are input-only so cannot be used as outputs.
			On the ESP32-S2, GPIO 46 is input-only so cannot be used as outputs.

	config CS_GPIO
		depends on SPI_INTERFACE
		int "CS GPIO number"
		range 0 SOC_GPIO_OUT_RANGE_MAX
		default  5 if IDF_TARGET_ESP32
		default 34 if IDF_TARGET_ESP32S2 || IDF_TARGET_ESP32S3
		default 10 # C3 and others
		help
			GPIO number (IOxx) to SPI CS.
			Some GPIOs are used for other purposes (flash connections, etc.) and cannot be used to CS.
			GPIOs 35-39 are input-only so cannot be used as outputs.

	config DC_GPIO
		depends on SPI_INTERFACE
		int "DC GPIO number"
		range 0 SOC_GPIO_OUT_RANGE_MAX
		default  4 if IDF_TARGET_ESP32
		default 37 if IDF_TARGET_ESP32S2 || IDF_TARGET_ESP32S3
		default  3 # C3 and others
		help
			GPIO number (IOxx) to SPI DC.
			Some GPIOs are used for other purposes (flash connections, etc.) and cannot be used to DC.
			GPIOs 35-39 are input-only so cannot be used as outputs.

	config RESET_GPIO
		int "RESET GPIO number"
		range -1 SOC_GPIO_OUT_RANGE_MAX
		default 15 if IDF_TARGET_ESP32
		default 38 if IDF_TARGET_ESP32S2 || IDF_TARGET_ESP32S3
		default  4 # C3 and others
		help
			GPIO number (IOxx) to RESET.
			When it is -1, RESET isn't performed.
			Some GPIOs are used for other purposes (flash connections, etc.) and cannot be used to RESET.
			GPIOs 35-39 are input-only so cannot be used as outputs.

	choice I2C_PORT
		depends on I2C_INTERFACE
		prompt "I2C port that controls this bus"
		default I2C_PORT_0
		help
			Select I2C port that controls this bus.
		config I2C_PORT_0
			bool "I2C_PORT_0"
			help
				Use I2C_PORT_0.
		config I2C_PORT_1
			depends on SOC_HP_I2C_NUM > 1
			bool "I2C_PORT_1"
			help
				Use I2C_PORT_1.
	endchoice

	config LEGACY_DRIVER
		depends on I2C_INTERFACE
		bool "Force legacy i2c driver"
		default false
		help
			Force legacy i2c driver.

	choice SPI_HOST
		depends on SPI_INTERFACE
		prompt "SPI peripheral that controls this bus"
		default SPI2_HOST
		help
			Select SPI peripheral that controls this bus.
		config SPI2_HOST
			bool "SPI2_HOST"
			help
				Use SPI2_HOST. This is also called HSPI_HOST.
		config SPI3_HOST
			depends on SOC_SPI_PERIPH_NUM > 2
			bool "SPI3_HOST"
			help
				USE SPI3_HOST. This is also called VSPI_HOST.
	endchoice

endmenu
```

## main/Kconfig.projbuild
```kconfig
menu "SSD1306 Configuration"

    config INTERFACE
        int "SSD1306 Interface"
        range 1 2
        default 1
        help
            1 : i2c Interface
            2 : SPI interface

    config MODEL
        int "SSD1306 Model"
        range 1 2
        default 1
        help
            1 : SSD1306_128x64 (128x64 panel)
            2 : SSD1306_128x32 (128x32 panel)

    config SCL_GPIO
        int "SCL GPIO number"
        range 0 34
        default 22
        help
            GPIO number (IOxx) to I2C SCL.

            Some GPIOs are used for other purposes (flash connections, etc.) and cannot be used to I2C.

            GPIOs 35-39 are input-only so cannot be used as outputs.

    config SDA_GPIO
        int "SDA GPIO number"
        range 0 34
        default 21
        help
            GPIO number (IOxx) to I2C SDA.

            Some GPIOs are used for other purposes (flash connections, etc.) and cannot be used to I2C.

            GPIOs 35-39 are input-only so cannot be used as outputs.

    config RESET_GPIO
        int "RESET GPIO number"
        range -1 34
        default -1
        help
            GPIO number (IOxx) to RESET.

			When it is -1, RESET isn't performed.
            Some GPIOs are used for other purposes (flash connections, etc.) and cannot be used to Reset.

            GPIOs 35-39 are input-only so cannot be used as outputs.

    config CS_GPIO
        int "CS GPIO number"
        range 0 34
        default 15
        help
            GPIO number (IOxx) to SPI CS.

            Some GPIOs are used for other purposes (flash connections, etc.) and cannot be used to CS.

            GPIOs 35-39 are input-only so cannot be used as outputs.

    config DC_GPIO
        int "DC GPIO number"
        range 0 34
        default 33
        help
            GPIO number (IOxx) to SPI DC.

            Some GPIOs are used for other purposes (flash connections, etc.) and cannot be used to DC.

            GPIOs 35-39 are input-only so cannot be used as outputs.

endmenu
```
