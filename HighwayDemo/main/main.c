#include <stdio.h>
#include <inttypes.h>
#include <stdlib.h>
#include <string.h>
#include "freertos/FreeRTOS.h"
#include "freertos/task.h"
#include "esp_log.h"

#include "ssd1306.h"

/*
 You have to set this config value with menuconfig
 CONFIG_INTERFACE

 for i2c
 CONFIG_MODEL
 CONFIG_SDA_GPIO
 CONFIG_SCL_GPIO
 CONFIG_RESET_GPIO

 for SPI
 CONFIG_CS_GPIO
 CONFIG_DC_GPIO
 CONFIG_RESET_GPIO
*/

#define TAG "SSD1306"

uint8_t highway11[] = {
// 'highway11', 128x64px
0xff, 0xff, 0xff, 0xff, 0xff, 0xe0, 0x00, 0x00, 0x00, 0x00, 0x03, 0xff, 0xff, 0xff, 0xff, 0xff, 
0xff, 0xff, 0xff, 0xff, 0xff, 0xe7, 0x00, 0x01, 0x80, 0x00, 0x73, 0xff, 0xff, 0xff, 0xff, 0xff, 
0xff, 0xff, 0xff, 0xff, 0xff, 0xe7, 0x00, 0x01, 0x80, 0x00, 0x73, 0xff, 0xff, 0xff, 0xff, 0xff, 
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0x38, 0x03, 0xf8, 0x07, 0xf8, 0x07, 0x00, 0x01, 0x80, 0x00, 0x70, 0x07, 0xf0, 0x0f, 0xf0, 0x0f
};

uint8_t highway12[] = {
// 'highway12', 128x64px
0x7c, 0x07, 0xf8, 0x07, 0xf8, 0x07, 0x00, 0x01, 0x80, 0x00, 0x70, 0x0f, 0xf8, 0x0f, 0xf0, 0x0f, 
0x00, 0x00, 0x00, 0x00, 0x00, 0x07, 0x00, 0x01, 0x80, 0x00, 0x70, 0x00, 0x00, 0x00, 0x00, 0x00, 
0x00, 0x00, 0x00, 0x00, 0x00, 0x07, 0x00, 0x01, 0x80, 0x00, 0x70, 0x00, 0x00, 0x00, 0x00, 0x00, 
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0xff, 0xff, 0xff, 0xff, 0xff, 0xe0, 0x00, 0x00, 0x80, 0x00, 0x03, 0xff, 0xff, 0xff, 0xff, 0xff
};

uint8_t highway21[] = {
// 'highway21', 128x64px
0xff, 0xff, 0xff, 0xff, 0xff, 0xe0, 0x00, 0x00, 0x00, 0x00, 0x03, 0xff, 0xff, 0xff, 0xff, 0xff, 
0xff, 0xff, 0xff, 0xff, 0xff, 0xe7, 0x00, 0x01, 0x80, 0x00, 0x73, 0xff, 0xff, 0xff, 0xff, 0xff, 
0xff, 0xff, 0xff, 0xff, 0xff, 0xef, 0x00, 0x01, 0x80, 0x00, 0xf3, 0xff, 0xff, 0xff, 0xff, 0xff, 
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0x78, 0x07, 0xf8, 0x07, 0xf8, 0x07, 0xf0, 0x07, 0xf0, 0x07, 0xf0, 0x0f, 0xf0, 0x0f, 0xf0, 0x0e
};

uint8_t highway22[] = {
// 'highway22', 128x64px
0x78, 0x07, 0xf8, 0x07, 0xf8, 0x0f, 0xf8, 0x0f, 0xf8, 0x0f, 0xf0, 0x0f, 0xf0, 0x0f, 0xf0, 0x0f, 
0x00, 0x00, 0x00, 0x00, 0x00, 0x00, 0x00, 0x00, 0x00, 0x00, 0x00, 0x00, 0x00, 0x00, 0x00, 0x00, 
0x00, 0x00, 0x00, 0x00, 0x00, 0x00, 0x00, 0x00, 0x00, 0x00, 0x00, 0x00, 0x00, 0x00, 0x00, 0x00, 
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0xff, 0xff, 0xff, 0xff, 0xff, 0xe0, 0x00, 0x01, 0x80, 0x00, 0x03, 0xff, 0xff, 0xff, 0xff, 0xff
};

uint8_t highway31[] = {
// 'highway31', 128x64px
0xff, 0xff, 0xff, 0xff, 0xff, 0xe7, 0x00, 0x01, 0x80, 0x00, 0xf7, 0xff, 0xff, 0xff, 0xff, 0xff, 
0xff, 0xff, 0xff, 0xff, 0xff, 0xe7, 0x00, 0x01, 0x80, 0x00, 0xf7, 0xff, 0xff, 0xff, 0xff, 0xff, 
0xff, 0xff, 0xff, 0xff, 0xff, 0xe7, 0x00, 0x00, 0x00, 0x00, 0xf7, 0xff, 0xff, 0xff, 0xff, 0xff, 
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0x9e, 0x00, 0x00, 0x0e, 0x00, 0x00, 0x03, 0xcf, 0xff, 0xff, 0xff, 0xff, 0xff, 0xff, 0xff, 0xff
};

uint8_t highway32[] = {
// 'highway32', 128x64px
0x3e, 0x00, 0x00, 0x1c, 0x00, 0x00, 0x07, 0x9f, 0xff, 0xff, 0xff, 0xff, 0xff, 0xff, 0xff, 0xff, 
0x7c, 0x00, 0x00, 0x38, 0x00, 0x00, 0x0f, 0x1f, 0xff, 0xff, 0xff, 0xff, 0xff, 0xff, 0xff, 0xff, 
0x78, 0x00, 0x00, 0x70, 0x00, 0x00, 0x1e, 0x3f, 0xff, 0xff, 0xff, 0xff, 0xff, 0xff, 0xff, 0xff, 
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0x00, 0x00, 0xe7, 0xff, 0xff, 0xff, 0xff, 0xff, 0xff, 0xff, 0xff, 0xff, 0xff, 0xff, 0xff, 0xff
};

uint8_t highway41[] = {
// 'highway41', 128x64px
0x80, 0x00, 0xe7, 0xff, 0xff, 0xff, 0xff, 0xff, 0xff, 0xff, 0xff, 0xff, 0xff, 0xff, 0xff, 0xff, 
0x80, 0x00, 0xe7, 0xff, 0xff, 0xff, 0xff, 0xff, 0xff, 0xff, 0xff, 0xff, 0xff, 0xff, 0xff, 0xff, 
0x00, 0x00, 0xe7, 0xff, 0xff, 0xff, 0xff, 0xff, 0xff, 0xff, 0xff, 0xff, 0xff, 0xff, 0xff, 0xff, 
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0xf3, 0xc0, 0x00, 0x00, 0x70, 0x00, 0x00, 0x79, 0xff, 0xff, 0xff, 0xff, 0xff, 0xff, 0xff, 0xff
};

uint8_t highway42[] = {
// 'highway42', 128x64px
0xf9, 0xe0, 0x00, 0x00, 0x38, 0x00, 0x00, 0x7c, 0xff, 0xff, 0xff, 0xff, 0xff, 0xff, 0xff, 0xff, 
0xf8, 0xf0, 0x00, 0x00, 0x1c, 0x00, 0x00, 0x3e, 0x7f, 0xff, 0xff, 0xff, 0xff, 0xff, 0xff, 0xff, 
0xfc, 0x78, 0x00, 0x00, 0x0e, 0x00, 0x00, 0x1e, 0x7f, 0xff, 0xff, 0xff, 0xff, 0xff, 0xff, 0xff, 
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0xff, 0xff, 0xff, 0xff, 0xff, 0xe7, 0x00, 0x00, 0x00, 0x00, 0xf7, 0xff, 0xff, 0xff, 0xff, 0xff
};

uint8_t car[] = {
0b00111000, 0b00011100,
0b00111111, 0b11111100,
0b11100000, 0b00000111,
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0b00111111, 0b11111100
};

void set_car(uint8_t *cars, int position, uint8_t flag, uint8_t *buffer, uint8_t *save) {
	int index = 0;
	for(int page=6;page<8;page++) {
		for(int seg=0;seg<16;seg++) {
			if (save) save[index] = buffer[page*128+seg+position];
			if (position < 0) continue;
			if (page == 6) {
				uint8_t _flag = flag & 0x01; 
				if (_flag == 0x01) 
					buffer[page*128+seg+position] = cars[index];
			} else {
				uint8_t _flag = flag & 0x02; 
				if (_flag == 0x02) 
					buffer[page*128+seg+position] = cars[index];
			}
			index++;
		}
	}
}

void app_main(void)
{
	SSD1306_t dev;

#if CONFIG_I2C_INTERFACE
	ESP_LOGI(TAG, "INTERFACE is i2c");
	ESP_LOGI(TAG, "CONFIG_SDA_GPIO=%d",CONFIG_SDA_GPIO);
	ESP_LOGI(TAG, "CONFIG_SCL_GPIO=%d",CONFIG_SCL_GPIO);
	ESP_LOGI(TAG, "CONFIG_RESET_GPIO=%d",CONFIG_RESET_GPIO);
	i2c_master_init(&dev, CONFIG_SDA_GPIO, CONFIG_SCL_GPIO, CONFIG_RESET_GPIO);
#endif // CONFIG_I2C_INTERFACE

#if CONFIG_SPI_INTERFACE
	ESP_LOGI(TAG, "INTERFACE is SPI");
	ESP_LOGI(TAG, "CONFIG_MOSI_GPIO=%d",CONFIG_MOSI_GPIO);
	ESP_LOGI(TAG, "CONFIG_SCLK_GPIO=%d",CONFIG_SCLK_GPIO);
	ESP_LOGI(TAG, "CONFIG_CS_GPIO=%d",CONFIG_CS_GPIO);
	ESP_LOGI(TAG, "CONFIG_DC_GPIO=%d",CONFIG_DC_GPIO);
	ESP_LOGI(TAG, "CONFIG_RESET_GPIO=%d",CONFIG_RESET_GPIO);
	spi_master_init(&dev, CONFIG_MOSI_GPIO, CONFIG_SCLK_GPIO, CONFIG_CS_GPIO, CONFIG_DC_GPIO, CONFIG_RESET_GPIO);
#endif // CONFIG_SPI_INTERFACE

#if CONFIG_FLIP
	dev._flip = true;
	ESP_LOGW(TAG, "Flip upside down");
#endif

#if CONFIG_SSD1306_128x64
	ESP_LOGI(TAG, "Panel is 128x64");
	ssd1306_init(&dev, 128, 64);
#endif // CONFIG_SSD1306_128x64
#if CONFIG_SSD1306_128x32
	ESP_LOGE(TAG, "Panel is 128x32. This demo cannot be run.");
	while(1) { vTaskDelay(1); }
#endif // CONFIG_SSD1306_128x32

	// Allocate memory for work frame
	uint8_t *wk = (uint8_t *)malloc(1024);
	if (wk == NULL) {
		ESP_LOGE(TAG, "malloc failed");
		while(1) { vTaskDelay(1); }
	}

	// Allocate memory for background frame
	uint8_t *buffer = (uint8_t *)malloc(1024*8);
	if (buffer == NULL) {
		ESP_LOGE(TAG, "malloc failed");
		while(1) { vTaskDelay(1); }
	}

	// Show car image
	ssd1306_contrast(&dev, 0xff);
	ssd1306_clear_screen(&dev, false);
	ssd1306_bitmaps(&dev, 0, 0, car, 16, 16, false);
	vTaskDelay(100);

	// Store car image
	ssd1306_get_buffer(&dev, wk);
	uint8_t carImage[32];
	uint8_t _carImage[32];
	int index = 0;
	for(int page=0;page<2;page++) {
		for(int seg=0;seg<16;seg++) {
			carImage[index++] = wk[page*128+seg];
		}
	}

#if 0
	for(int position=0;position<10;position++) {
		ssd1306_clear_screen(&dev, false);
		ssd1306_get_buffer(&dev, wk);
		set_car(carImage, position, 0x03, wk, _carImage);
		ssd1306_set_buffer(&dev, wk);
		ssd1306_show_buffer(&dev);
		vTaskDelay(100);
	}
#endif

	ssd1306_bitmaps(&dev, 0, 0, highway12, 128, 64, false);
	ssd1306_get_buffer(&dev, &buffer[1024*0]);
	vTaskDelay(10);

	ssd1306_bitmaps(&dev, 0, 0, highway11, 128, 64, false);
	ssd1306_get_buffer(&dev, &buffer[1024*1]);
	vTaskDelay(10);

	ssd1306_bitmaps(&dev, 0, 0, highway42, 128, 64, false);
	ssd1306_get_buffer(&dev, &buffer[1024*2]);
	vTaskDelay(10);

	ssd1306_bitmaps(&dev, 0, 0, highway41, 128, 64, false);
	ssd1306_get_buffer(&dev, &buffer[1024*3]);
	vTaskDelay(10);

	ssd1306_bitmaps(&dev, 0, 0, highway32, 128, 64, false);
	ssd1306_get_buffer(&dev, &buffer[1024*4]);
	vTaskDelay(10);

	ssd1306_bitmaps(&dev, 0, 0, highway31, 128, 64, false);
	ssd1306_get_buffer(&dev, &buffer[1024*5]);
	vTaskDelay(10);

	ssd1306_bitmaps(&dev, 0, 0, highway22, 128, 64, false);
	ssd1306_get_buffer(&dev, &buffer[1024*6]);
	vTaskDelay(10);

	ssd1306_bitmaps(&dev, 0, 0, highway21, 128, 64, false);
	ssd1306_get_buffer(&dev, &buffer[1024*7]);
	vTaskDelay(10);

	// Show initial background
	ssd1306_set_buffer(&dev, &buffer[1024*0]);
	ssd1306_show_buffer(&dev);
	vTaskDelay(10);

	int frameIndex=1;
	int positions[8];
	uint8_t flag[8];
	for (int i=0;i<8;i++) positions[i] = 56; // Center posaition
	memset(flag, 0x03, 8); // Display the entire car
	int interval = 0;
	while(1) {
		int frameOffset = frameIndex*1024;
		for (int page=0;page<8;page++) {
			ssd1306_wrap_arround(&dev, PAGE_SCROLL_DOWN, 0, 0, -1);

			// Get from internal buffer to local buffer
			// buffer is [8][128] 8 page 128 pixel
			ssd1306_get_buffer(&dev, wk);

			// Update buffer
			int dst_index = 0;
			int src_index = (7-page)*128+frameOffset;
			ESP_LOGD(TAG, "frameIndex=%d page=%d src_index=%d", frameIndex, page, src_index);
			for (int seg=0;seg<128;seg++) {
				wk[dst_index++] = buffer[src_index++];
			}

			// Set car bitmap
			set_car(carImage, positions[page], flag[page], wk, _carImage);
			ssd1306_set_buffer(&dev, wk);

			// Show internal buffer
			ssd1306_show_buffer(&dev);

			//	Reset car bitmap
			set_car(_carImage, positions[page], flag[page], wk, NULL);
			ssd1306_set_buffer(&dev, wk);
#if CONFIG_SPI_INTERFACE
			vTaskDelay(2);
#endif
			vTaskDelay(interval);
		}

		// Set nect background
		frameIndex++;
		if (frameIndex > 7) frameIndex=0;

		// Set car position
		for (int i=0;i<8;i++) positions[i] = 56; // Center position
		memset(flag, 0x03, 8); // Display the entire car
		interval = 0;
		if (frameIndex == 3) { // left curve
			positions[0] = 56;
			positions[1] = 54;
			positions[2] = 50;
			positions[3] = 46;
			positions[4] = 42;
			positions[5] = 36;
			positions[6] = 26;
			positions[7] = 18;
			//interval=200;
		} else if (frameIndex == 4) { // left curve
			positions[0] = 12;
			positions[1] = 6;
			positions[2] = 4;
			positions[3] = 0;
			positions[4] = 0;
			positions[5] = 0;
			positions[6] = 0;
			positions[7] = 0;
			//interval=100;
		} else if (frameIndex == 5) { // right curve
			positions[0] = 0;
			positions[1] = 0;
			positions[2] = 0;
			positions[3] = 2;
			positions[4] = 6;
			positions[5] = 12;
			positions[6] = 18;
			positions[7] = 28;
			//interval=100;
		} else if (frameIndex == 6) { // right curve
			positions[0] = 34;
			positions[1] = 42;
			positions[2] = 46;
			positions[3] = 50;
			positions[4] = 54;
			positions[5] = 56;
			positions[6] = 56;
			positions[7] = 56;
			//interval=100;
		} else if (frameIndex == 7) { // under cross
			positions[0] = 56;
			positions[1] = 56;
			positions[2] = 56;
			positions[3] = 56;
			positions[4] = -1;
			positions[5] = -1;
			positions[6] = -1;
			positions[7] = -1;
			flag[3] = 0x02; // Show only the rear of the car
			//interval=100;
		} else if (frameIndex == 0) { // under cross
			positions[0] = -1;
			positions[1] = 56;
			positions[2] = 56;
			positions[3] = 56;
			positions[4] = 56;
			positions[5] = 56;
			positions[6] = 56;
			positions[7] = 56;
			flag[1] = 0x01; // Show only the front of the car
			//interval=100;
		}
	}
}
