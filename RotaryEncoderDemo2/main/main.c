#include <stdio.h>
#include <inttypes.h>
#include <stdlib.h>
#include <string.h>
#include "freertos/FreeRTOS.h"
#include "freertos/task.h"
#include "esp_log.h"

#include "RotaryEncoder.h"
#include "ssd1306.h"

/*
 You have to set this config value with menuconfig
 CONFIG_INTERFACE

 for i2c
 CONFIG_MODEL
 CONFIG_SDA_GPIO
 CONFIG_SCL_GPIO
 CONFIG_RESET_GPIO

 for SPI
 CONFIG_CS_GPIO
 CONFIG_DC_GPIO
 CONFIG_RESET_GPIO
*/

#define TAG "SSD1306"

// https://iitestudent.blogspot.com/2013/01/displaying-bitmap-on-graphic-lcd.html
uint8_t fleischer1[] = {
// 'fleischer1', 420x64px
0xff, 0xff, 0xff, 0xff, 0xff, 0xff, 0xff, 0xff, 0xff, 0xff, 0xff, 0xff, 0xff, 0xff, 0xff, 0xff, 
0xff, 0xff, 0xff, 0xfe, 0x3f, 0xfe, 0x0f, 0xff, 0xff, 0xff, 0xff, 0xff, 0xff, 0xff, 0xff, 0xff, 
0xff, 0xff, 0xff, 0xff, 0xff, 0xff, 0xff, 0xff, 0xff, 0xff, 0xff, 0xff, 0xff, 0xff, 0xff, 0xff, 
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0x80, 0x03, 0xff, 0xff, 0xff, 0xff, 0xff, 0xff, 0xff, 0xff, 0xff, 0xff, 0xff, 0xff, 0xff, 0xf0
};

uint8_t fleischer2[] = {
// 'fleischer2', 128x184px
// 'fleischer2', 128x184px
0xff, 0xfe, 0x3f, 0xfe, 0x0f, 0xff, 0xff, 0xff, 0xff, 0xff, 0xff, 0xff, 0xff, 0xff, 0xff, 0xff, 
0xff, 0xfe, 0x7f, 0xff, 0x00, 0x0f, 0xff, 0xff, 0xff, 0xff, 0xff, 0xff, 0xff, 0xff, 0xff, 0xff, 
0xff, 0xfc, 0xff, 0xff, 0xff, 0xe3, 0xff, 0xff, 0xff, 0xff, 0xff, 0xff, 0xff, 0xff, 0xff, 0xff, 
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0xff, 0xff, 0xfe, 0x8f, 0xff, 0xff, 0xff, 0xff, 0xff, 0xff, 0xff, 0xff, 0xff, 0xff, 0xff, 0xff
};

void app_main(void)
{
	SSD1306_t dev;

#if CONFIG_I2C_INTERFACE
	ESP_LOGI(TAG, "INTERFACE is i2c");
	ESP_LOGI(TAG, "CONFIG_SDA_GPIO=%d",CONFIG_SDA_GPIO);
	ESP_LOGI(TAG, "CONFIG_SCL_GPIO=%d",CONFIG_SCL_GPIO);
	ESP_LOGI(TAG, "CONFIG_RESET_GPIO=%d",CONFIG_RESET_GPIO);
	i2c_master_init(&dev, CONFIG_SDA_GPIO, CONFIG_SCL_GPIO, CONFIG_RESET_GPIO);
#endif // CONFIG_I2C_INTERFACE

#if CONFIG_SPI_INTERFACE
	ESP_LOGI(TAG, "INTERFACE is SPI");
	ESP_LOGI(TAG, "CONFIG_MOSI_GPIO=%d",CONFIG_MOSI_GPIO);
	ESP_LOGI(TAG, "CONFIG_SCLK_GPIO=%d",CONFIG_SCLK_GPIO);
	ESP_LOGI(TAG, "CONFIG_CS_GPIO=%d",CONFIG_CS_GPIO);
	ESP_LOGI(TAG, "CONFIG_DC_GPIO=%d",CONFIG_DC_GPIO);
	ESP_LOGI(TAG, "CONFIG_RESET_GPIO=%d",CONFIG_RESET_GPIO);
	spi_master_init(&dev, CONFIG_MOSI_GPIO, CONFIG_SCLK_GPIO, CONFIG_CS_GPIO, CONFIG_DC_GPIO, CONFIG_RESET_GPIO);
#endif // CONFIG_SPI_INTERFACE

#if 0
#if CONFIG_FLIP
	dev._flip = true;
	ESP_LOGW(TAG, "Flip upside down");
#endif
#endif

#if CONFIG_SSD1306_128x64
	ESP_LOGI(TAG, "Panel is 128x64");
	ssd1306_init(&dev, 128, 64);
#endif // CONFIG_SSD1306_128x64
#if CONFIG_SSD1306_128x32
	ESP_LOGE(TAG, "Panel is 128x32. This demo cannot be run.");
	while(1) { vTaskDelay(1); }
#endif // CONFIG_SSD1306_128x32

	size_t image_width1 = 420;
	// Calculate width of image data in bytes
	size_t width_bytes1 = (image_width1+7)/8;
	ESP_LOGI(TAG, "image_width1=%d --> width_bytes1=%d", image_width1, width_bytes1);
	// Calculate the number of frames to display all images
	size_t frames1 = width_bytes1 - 16 + 1;
	ESP_LOGI(TAG, "frames1=%d", frames1);

	
	size_t image_width2 = 128;
	// Calculate width of image data in bytes
	size_t width_bytes2 = (image_width2+7)/8;
	ESP_LOGI(TAG, "image_width2=%d --> width_bytes2=%d", image_width2, width_bytes2);
	size_t image_height = 184;
	// Calculate the number of frames to display all images
	size_t frames2 = (image_height-64) / 8 + 1;
	ESP_LOGI(TAG, "frames2=%d", frames2);

	// Allocates memory for one frame
	uint8_t *bitmap = (uint8_t *)malloc(1024);
	if (bitmap == NULL) {
		ESP_LOGE(TAG, "malloc failed");
		while(1) { vTaskDelay(1); }
	}

	// Allocate memory for all frame
	uint8_t *buffer1 = (uint8_t *)malloc(1024*frames1);
	if (buffer1 == NULL) {
		ESP_LOGE(TAG, "malloc failed");
		while(1) { vTaskDelay(1); }
	}

	// Allocate memory for all frame
	uint8_t *buffer2 = (uint8_t *)malloc(1024*frames2);
	if (buffer2 == NULL) {
		ESP_LOGE(TAG, "malloc failed");
		while(1) { vTaskDelay(1); }
	}

	// Convert from segmentDisplay to segmentImage
	for (int frame_offset=0;frame_offset<frames1;frame_offset++) {
		ESP_LOGI(TAG, "Convert %dth pixel to %dth pixel to frame[%d]", frame_offset*8,	frame_offset*8+127, frame_offset);
		if (frame_offset*8+127 > image_width1) {
			ESP_LOGW(TAG, "The right edge of the last frame is invalid data");
		}
		for (int i=0;i<64;i++) {
			for (int j=0;j<16;j++) {
				int src_index = (i*width_bytes1)+j+frame_offset;
				int dst_index = (i*16)+j;
				bitmap[dst_index] = fleischer1[src_index];
			}
		}

		ssd1306_bitmaps(&dev, 0, 0, bitmap, 128, 64, false);

		// Get from internal buffer to local buffer
		// buffer is [8][128] 8 page 128 pixel
		int buffer_index = frame_offset * 1024;
		ssd1306_get_buffer(&dev, &buffer1[buffer_index]);
	}

	for (int frame_offset=0;frame_offset<frames2;frame_offset++) {
		ESP_LOGI(TAG, "Convert %dth page to %dth page to frame[%d]", frame_offset, frame_offset+7, frame_offset);
		for (int i=0;i<64;i++) {
			for (int j=0;j<16;j++) {
				int src_index = (i*width_bytes2)+j+(frame_offset*8*width_bytes2);
				int dst_index = (i*16)+j;
				bitmap[dst_index] = fleischer2[src_index];
			}
		}

		ssd1306_bitmaps(&dev, 0, 0, bitmap, 128, 64, false);

		// Get from internal buffer to local buffer
		// buffer is [8][128] 8 page 128 pixel
		int buffer_index = frame_offset * 1024;
		ssd1306_get_buffer(&dev, &buffer2[buffer_index]);
	}


	// I don't use this anymore
	free(bitmap);

	ssd1306_contrast(&dev, 0xff);
	ssd1306_clear_screen(&dev, false);

	int center_frame1 = (frames1/2)-1;
	int center_frame2 = (frames2/2)-1;
	ESP_LOGI(TAG, "center_frame1=%d center_frame2=%d", center_frame1, center_frame2);
	int buffer_index = center_frame1 * 1024;
	ssd1306_set_buffer(&dev, &buffer1[buffer_index]);
	ssd1306_show_buffer(&dev);
	vTaskDelay(1);

	// Initialize RotaryEncoder
	initRotaryEncoder(CONFIG_GPIO_OUT_A, CONFIG_GPIO_OUT_B, CONFIG_GPIO_SWITCH, NULL);

	int prev_count; // Previus encoder count value
	int now_count; // Current encoder count value
	int sw; // Current encoder switch value
	int interrupt; // Interrupt occurrence count
	int event = readRotaryEncoder(&prev_count, &sw, &interrupt);

	int offset = center_frame1;
	int direction = 0;
	int offsetMax = frames1;
	while(1) {
		event = readRotaryEncoder(&now_count, &sw, &interrupt);
		if (event == 0) {
			// When the encoder is rotated
			int diff_count = prev_count - now_count;
			ESP_LOGI(TAG, "prev_count=%d now_count=%d diff_count=%d", prev_count, now_count, diff_count);
			if (diff_count > 0) {
				offset++;
				if (offset == offsetMax) offset = offsetMax - 1;
			} else {
				offset--;
				if (offset < 0) offset = 0;
			}
			ESP_LOGI(TAG, "frames1=%d frames2=%d direction=%d offset=%d", frames1, frames2, direction, offset);
			int buffer_index = offset * 1024;
			if (direction == 0) {
				ssd1306_set_buffer(&dev, &buffer1[buffer_index]);
			} else {
				ssd1306_set_buffer(&dev, &buffer2[buffer_index]);
			}
			ssd1306_show_buffer(&dev);
			prev_count = now_count;
		} else if (event == 1 && sw == 0) {
			// When the switch is pressed
			ESP_LOGI(TAG, "sw=%d", sw);
			if (direction == 0) {
				offset = 0;
				direction = 1;
				offsetMax = frames2;
				buffer_index = offset * 1024;
				ssd1306_set_buffer(&dev, &buffer2[buffer_index]);
			} else {
				offset = center_frame1;
				direction = 0;
				offsetMax = frames1;
				buffer_index = offset * 1024;
				ssd1306_set_buffer(&dev, &buffer1[buffer_index]);
			}
			ssd1306_show_buffer(&dev);
		}
		vTaskDelay(1);
	}
}
