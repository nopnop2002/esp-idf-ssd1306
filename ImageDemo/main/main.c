#include <stdio.h>
#include <stdlib.h>
#include <string.h>
#include "freertos/FreeRTOS.h"
#include "freertos/task.h"
#include "esp_log.h"

#include "ssd1306.h"
#include "font8x8_basic.h"

/*
 You have to set this config value with menuconfig
 CONFIG_INTERFACE

 for i2c
 CONFIG_MODEL
 CONFIG_SDA_GPIO
 CONFIG_SCL_GPIO
 CONFIG_RESET_GPIO

 for SPI
 CONFIG_CS_GPIO
 CONFIG_DC_GPIO
 CONFIG_RESET_GPIO
*/

#define TAG "SSD1306"

// https://www.mischianti.org/2021/07/14/ssd1306-oled-display-draw-images-splash-and-animations-2/
uint8_t batman[] = {
		0b11111111, 0b11111111, 0b11111111, 0b11111111,
		0b11111111, 0b10011111, 0b11111001, 0b11111111,
		0b11111110, 0b00111110, 0b01111100, 0b01111111,
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		0b11111111, 0b11111111, 0b11111111, 0b11111111
};

// https://www.mischianti.org/2021/07/14/ssd1306-oled-display-draw-images-splash-and-animations-2/
uint8_t logoMischianti [1024] = {
		// 'logoBN128x64, 128x64px
		0x00, 0x00, 0x00, 0x00, 0x00, 0x00, 0x00, 0xc0, 0x03, 0x00, 0x00, 0x00, 0x00, 0x00, 0x00, 0x00,
		0x00, 0x00, 0x00, 0x00, 0x00, 0x00, 0x01, 0xe0, 0x07, 0x80, 0x00, 0x00, 0x00, 0x00, 0x00, 0x00,
		0x00, 0x00, 0x00, 0x00, 0x00, 0x00, 0x01, 0xe0, 0x07, 0x80, 0x00, 0x00, 0x00, 0x00, 0x00, 0x00,
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		0x00, 0x00, 0x00, 0x00, 0x00, 0x00, 0x00, 0x00, 0x00, 0x00, 0x00, 0x00, 0x00, 0x00, 0x3c, 0x00
};

// https://iitestudent.blogspot.com/2013/01/displaying-bitmap-on-graphic-lcd.html
uint8_t fleischer [1024] = {
	// 'fleischer_420', 128x64px
	0xff, 0xff, 0xff, 0xff, 0xff, 0xff, 0xff, 0xff, 0xff, 0xff, 0xff, 0xff, 0xff, 0xff, 0xff, 0xff, 
	0xff, 0xff, 0xff, 0xff, 0xff, 0xff, 0xff, 0xff, 0xff, 0xff, 0xff, 0xff, 0xff, 0xff, 0xff, 0xff, 
	0xff, 0xff, 0xff, 0xff, 0xff, 0xff, 0xff, 0xff, 0xff, 0xff, 0xff, 0xff, 0xff, 0xff, 0xff, 0xff, 
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	0x00, 0x00, 0x00, 0x01, 0xcf, 0xce, 0x7f, 0xff, 0xfe, 0x3f, 0xff, 0xff, 0xfe, 0xca, 0x6f, 0xff
};

void app_main(void)
{
	SSD1306_t dev;

#if CONFIG_I2C_INTERFACE
	ESP_LOGI(TAG, "INTERFACE is i2c");
	ESP_LOGI(TAG, "CONFIG_SDA_GPIO=%d",CONFIG_SDA_GPIO);
	ESP_LOGI(TAG, "CONFIG_SCL_GPIO=%d",CONFIG_SCL_GPIO);
	ESP_LOGI(TAG, "CONFIG_RESET_GPIO=%d",CONFIG_RESET_GPIO);
	i2c_master_init(&dev, CONFIG_SDA_GPIO, CONFIG_SCL_GPIO, CONFIG_RESET_GPIO);
#endif // CONFIG_I2C_INTERFACE

#if CONFIG_SPI_INTERFACE
	ESP_LOGI(TAG, "INTERFACE is SPI");
	ESP_LOGI(TAG, "CONFIG_MOSI_GPIO=%d",CONFIG_MOSI_GPIO);
	ESP_LOGI(TAG, "CONFIG_SCLK_GPIO=%d",CONFIG_SCLK_GPIO);
	ESP_LOGI(TAG, "CONFIG_CS_GPIO=%d",CONFIG_CS_GPIO);
	ESP_LOGI(TAG, "CONFIG_DC_GPIO=%d",CONFIG_DC_GPIO);
	ESP_LOGI(TAG, "CONFIG_RESET_GPIO=%d",CONFIG_RESET_GPIO);
	spi_master_init(&dev, CONFIG_MOSI_GPIO, CONFIG_SCLK_GPIO, CONFIG_CS_GPIO, CONFIG_DC_GPIO, CONFIG_RESET_GPIO);
#endif // CONFIG_SPI_INTERFACE

#if CONFIG_FLIP
	dev._flip = true;
	ESP_LOGW(TAG, "Flip upside down");
#endif

#if CONFIG_SSD1306_128x64
	ESP_LOGI(TAG, "Panel is 128x64");
	ssd1306_init(&dev, 128, 64);
#endif // CONFIG_SSD1306_128x64
#if CONFIG_SSD1306_128x32
	ESP_LOGI(TAG, "Panel is 128x32");
	ssd1306_init(&dev, 128, 32);
#endif // CONFIG_SSD1306_128x32

	ssd1306_contrast(&dev, 0xff);

#if 0
	// for test code
	int srcBits = 7;
	int dstBits = 0;
	for (int i=0;i<8;i++) {
		uint8_t dst = 0;
		dst = ssd1306_copy_bit(0xf0, srcBits, dst, dstBits);
		ESP_LOGI(TAG, "dst=%02x", dst);
		srcBits--;
		dstBits++;
	}
	srcBits = 7;
	dstBits = 0;
	for (int i=0;i<8;i++) {
		uint8_t dst = 0;
		dst = ssd1306_copy_bit(0x0f, srcBits, dst, dstBits);
		ESP_LOGI(TAG, "dst=%02x", dst);
		srcBits--;
		dstBits++;
	}
#endif

	while(1) {
		ssd1306_clear_screen(&dev, false);
#if CONFIG_SSD1306_128x64
		ssd1306_display_text(&dev, 0, "SSD1306 128x64", 14, false);
#endif // CONFIG_SSD1306_128x64

#if CONFIG_SSD1306_128x32
		ssd1306_display_text(&dev, 0, "SSD1306 128x32", 14, false);
#endif // CONFIG_SSD1306_128x32
		ssd1306_display_text(&dev, 1, "BATMAN", 6, false);

		int bitmapWidth = 4*8;
		int width = ssd1306_get_width(&dev);
		int xpos = width / 2; // center of width
		xpos = xpos - bitmapWidth/2; 
		int ypos = 16;
		ESP_LOGD(TAG, "width=%d xpos=%d", width, xpos);
		ssd1306_bitmaps(&dev, xpos, ypos, batman, 32, 13, false);
		vTaskDelay(3000 / portTICK_PERIOD_MS);

		for(int i=0;i<128;i++) {
			ssd1306_wrap_arround(&dev, SCROLL_RIGHT, 2, 3, 0);
		}
		vTaskDelay(2000 / portTICK_PERIOD_MS);

#if CONFIG_SSD1306_128x64
		ssd1306_clear_screen(&dev, false);
		ssd1306_bitmaps(&dev, 0, 0, logoMischianti, 128, 64, false);
		vTaskDelay(2000 / portTICK_PERIOD_MS);

		for(int i=0;i<64;i++) {
			ssd1306_wrap_arround(&dev, SCROLL_UP, 0, 127, 0);
		}
		vTaskDelay(2000 / portTICK_PERIOD_MS);

		ssd1306_clear_screen(&dev, false);
		ssd1306_bitmaps(&dev, 0, 0, fleischer, 128, 64, false);
		vTaskDelay(2000 / portTICK_PERIOD_MS);
#endif
	}
}
