#include <stdio.h>
#include <stdlib.h>
#include <string.h>
#include "freertos/FreeRTOS.h"
#include "freertos/task.h"
#include "esp_log.h"

#include "ssd1306.h"
//#include "font8x8_basic.h"

/*
 You have to set this config value with menuconfig
 CONFIG_INTERFACE

 for i2c
 CONFIG_MODEL
 CONFIG_SDA_GPIO
 CONFIG_SCL_GPIO
 CONFIG_RESET_GPIO

 for SPI
 CONFIG_CS_GPIO
 CONFIG_DC_GPIO
 CONFIG_RESET_GPIO
*/

#define TAG "SSD1306"

// https://www.instructables.com/How-to-use-OLED-display-arduino-module/
// 'bentlay', 128x64px
uint8_t bentlay[] = {
0xff, 0xff, 0xff, 0xff, 0xff, 0xff, 0xff, 0xff, 0xff, 0xff, 0xff, 0xff, 0xff, 0xff, 0xff, 0xff, 
0xff, 0xff, 0xff, 0xff, 0xff, 0xff, 0xff, 0xff, 0xff, 0xff, 0xff, 0xff, 0xff, 0xff, 0xff, 0xff, 
0xff, 0xff, 0xff, 0xff, 0xff, 0xff, 0xff, 0xff, 0xff, 0xff, 0xff, 0xff, 0xff, 0xff, 0xff, 0xff, 
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0xff, 0xff, 0xff, 0xff, 0xff, 0xff, 0xff, 0xff, 0xff, 0xff, 0xff, 0xff, 0xff, 0xff, 0xff, 0xff
};

uint8_t RotateByte(uint8_t ch1) {
	uint8_t ch2 = 0;
	int j;
	for (j=0;j<8;j++) {
		ch2 = (ch2 << 1) + (ch1 & 0x01);
		ch1 = ch1 >> 1;
	}
	return ch2;
}

void app_main(void)
{
	SSD1306_t dev;

#if CONFIG_I2C_INTERFACE
	ESP_LOGI(TAG, "INTERFACE is i2c");
	ESP_LOGI(TAG, "CONFIG_SDA_GPIO=%d",CONFIG_SDA_GPIO);
	ESP_LOGI(TAG, "CONFIG_SCL_GPIO=%d",CONFIG_SCL_GPIO);
	ESP_LOGI(TAG, "CONFIG_RESET_GPIO=%d",CONFIG_RESET_GPIO);
	i2c_master_init(&dev, CONFIG_SDA_GPIO, CONFIG_SCL_GPIO, CONFIG_RESET_GPIO);
#endif // CONFIG_I2C_INTERFACE

#if CONFIG_SPI_INTERFACE
	ESP_LOGI(TAG, "INTERFACE is SPI");
	ESP_LOGI(TAG, "CONFIG_MOSI_GPIO=%d",CONFIG_MOSI_GPIO);
	ESP_LOGI(TAG, "CONFIG_SCLK_GPIO=%d",CONFIG_SCLK_GPIO);
	ESP_LOGI(TAG, "CONFIG_CS_GPIO=%d",CONFIG_CS_GPIO);
	ESP_LOGI(TAG, "CONFIG_DC_GPIO=%d",CONFIG_DC_GPIO);
	ESP_LOGI(TAG, "CONFIG_RESET_GPIO=%d",CONFIG_RESET_GPIO);
	spi_master_init(&dev, CONFIG_MOSI_GPIO, CONFIG_SCLK_GPIO, CONFIG_CS_GPIO, CONFIG_DC_GPIO, CONFIG_RESET_GPIO);
#endif // CONFIG_SPI_INTERFACE

#if CONFIG_FLIP
	dev._flip = true;
	ESP_LOGW(TAG, "Flip upside down");
#endif

#if CONFIG_SSD1306_128x64
	ESP_LOGI(TAG, "Panel is 128x64");
	ssd1306_init(&dev, 128, 64);
#endif // CONFIG_SSD1306_128x64
#if CONFIG_SSD1306_128x32
	ESP_LOGE(TAG, "Panel is 128x32. This demo cannot be run.");
	while(1) { vTaskDelay(1); }
#endif // CONFIG_SSD1306_128x32

	// Allocate memory for work frame
	uint8_t *buffer1 = (uint8_t *)malloc(1024);
	if (buffer1 == NULL) {
		ESP_LOGE(TAG, "malloc failed");
		while(1) { vTaskDelay(1); }
	}

	uint8_t *buffer2 = (uint8_t *)malloc(1024);
	if (buffer2 == NULL) {
		ESP_LOGE(TAG, "malloc failed");
		while(1) { vTaskDelay(1); }
	}

	uint8_t *buffer3 = (uint8_t *)malloc(1024);
	if (buffer3 == NULL) {
		ESP_LOGE(TAG, "malloc failed");
		while(1) { vTaskDelay(1); }
	}

	uint8_t *buffer4 = (uint8_t *)malloc(1024);
	if (buffer4 == NULL) {
		ESP_LOGE(TAG, "malloc failed");
		while(1) { vTaskDelay(1); }
	}

	ssd1306_contrast(&dev, 0xff);
	ssd1306_clear_screen(&dev, false);
	ssd1306_bitmaps(&dev, 0, 0, bentlay, 128, 64, false);
	vTaskDelay(2000 / portTICK_PERIOD_MS);

#if 0
	// 0b00010011 --> 0b11001000
	uint8_t ch1 = 0x13;
	uint8_t ch2 = RotateByte(ch1);
	ESP_LOGI(TAG, "ch1=0x%x ch2=0x%x", ch1, ch2);
#endif

	// generate inverted image
	for (int page=0;page<8;page++) {
		int index1 = page * 128;
		ssd1306_get_page(&dev, page, &buffer1[index1]);
		for (int seg=0;seg<128;seg++) {
			buffer2[index1+seg] = ~buffer1[index1+seg];
		}
		vTaskDelay(1);
	}

	// generate fliped image
	for (int page=0;page<8;page++) {
		int index1 = page * 128;
		int index2 = index1 + 127;
		ssd1306_get_page(&dev, page, &buffer1[index1]);
		for (int seg=0;seg<64;seg++) {
			ESP_LOGD(TAG, "index1=%d index2=%d", index1, index2);
			uint8_t wk1 = buffer1[index1];
			uint8_t wk2 = buffer1[index2];
			wk1 = RotateByte(wk1);
			wk2 = RotateByte(wk2);
			buffer3[index1++] = wk2;
			buffer3[index2--] = wk1;
		}
		vTaskDelay(1);
	}

	// generate fliped and inverted image
	for (int page=0;page<8;page++) {
		int index1 = page * 128;
		for (int seg=0;seg<128;seg++) {
			buffer4[index1+seg] = ~buffer3[index1+seg];
		}
		vTaskDelay(1);
	}

	while(1) {
		for (int page=0;page<8;page++) {
			int index = page * 128;
			ssd1306_set_page(&dev, page, &buffer1[index]);
			ssd1306_show_buffer(&dev);
			vTaskDelay(5);
		}
		vTaskDelay(2000 / portTICK_PERIOD_MS);

		//for (int page=0;page<8;page++) {
		for (int page=0;page<4;page++) {
			int index = page * 128;
			ssd1306_set_page(&dev, page, &buffer2[index]);
			ssd1306_show_buffer(&dev);
			vTaskDelay(5);
		}
		vTaskDelay(2000 / portTICK_PERIOD_MS);

		//for (int page=7;page>=0;page--) {
		for (int page=7;page>=4;page--) {
			int index = (7-page)*128;
			ssd1306_set_page(&dev, page, &buffer3[index]);
			ssd1306_show_buffer(&dev);
			vTaskDelay(5);
		}
		vTaskDelay(2000 / portTICK_PERIOD_MS);

		//for (int page=7;page>=0;page--) {
		for (int page=3;page>=0;page--) {
			int index = (7-page)*128;
			ssd1306_set_page(&dev, page, &buffer4[index]);
			ssd1306_show_buffer(&dev);
			vTaskDelay(5);
		}
		vTaskDelay(2000 / portTICK_PERIOD_MS);

		for (int page=7;page>=4;page--) {
			int index = (7-page)*128;
			ssd1306_set_page(&dev, page, &buffer4[index]);
			ssd1306_show_buffer(&dev);
			vTaskDelay(5);
		}
		vTaskDelay(2000 / portTICK_PERIOD_MS);
	}
}
